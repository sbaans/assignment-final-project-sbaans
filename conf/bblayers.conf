## conf/bblayers.conf
```bitbake
# POKY_BBLAYERS_CONF_VERSION is increased each time build/conf/bblayers.conf
# changes incompatibly
POKY_BBLAYERS_CONF_VERSION = "2"

BBPATH = "${TOPDIR}"
BBFILES ?= ""

BBLAYERS ?= " \
  /home/sebbans/coursera/assignment-final-project-sbaans/poky/meta \
  /home/sebbans/coursera/assignment-final-project-sbaans/poky/meta-poky \
  /home/sebbans/coursera/assignment-final-project-sbaans/poky/meta-yocto-bsp \
  /home/sebbans/coursera/assignment-final-project-sbaans/meta-raspberrypi \
  "
```
